/*
 * heron living loop — STAGE B PLAYER (DRAFT, gate-held — see
 * STAGE_B_MANIFEST.md). This file is NOT referenced by main/CMakeLists.txt
 * and does not change the Stage A build in any way. It is the complete
 * Stage B player, written against the Stage A proven decode/display path,
 * ready to become main/main.c the moment a storage option is chosen:
 *
 *   - If clips stay EMBEDDED (flash subset options), the extern symbol
 *     table below is already correct: name the .mjpeg files in
 *     main/CMakeLists.txt EMBED_FILES exactly as the symbols expect.
 *   - If clips move to microSD (recommended option A), only the frame
 *     source changes: replace the blob cursor with a file reader that
 *     yields the same SOI..EOI spans. Decode, present, scheduler and
 *     crossfade code are untouched by that swap.
 *
 * What Stage B adds over Stage A (main/main.c, proven on the board):
 *   1. The shuffle-bag scheduler, ported from living_loop_scheduler.py:
 *      tickets preen x3, stride x3, strike x2, stretch x2, miss x2,
 *      flight x1, courtship x1 (14 tickets; nightstalk excluded — no
 *      light sensor in the kit). Draws WITHOUT replacement; on refill
 *      the bag is reshuffled until its first ticket differs from the
 *      behavior that just played. Randomized idle holds of 20–90 s
 *      (idle1 10 s blocks sprinkled into idle2 tiles, unit order
 *      shuffled) open the loop and sit between every draw. Every cycle
 *      starts/ends on the shared alert stance.
 *   2. A ~0.33 s CROSSFADE at every unit join (Jimmy's catch on Stage A:
 *      generated clips and the plate-warp idle are different renderings
 *      and hard cuts pop). The first 4 frames of an incoming unit are
 *      blended against the last shown frame in a dedicated blend buffer;
 *      the shown buffer is never written while LVGL may be scanning it.
 *   3. Randomness from esp_random(); the boot seed value is logged, and
 *      every draw / hold / reshuffle is logged on serial.
 *
 * Board/display/decoder configuration is byte-for-byte Stage A:
 * BSP 1.0.4 display path, esp_driver_jpeg YUV422 -> RGB565,
 * JPEG_DEC_RGB_ELEMENT_ORDER_BGR (proven correct on the panel).
 */
#include <stddef.h>
#include <stdint.h>
#include <string.h>

#include "freertos/FreeRTOS.h"
#include "freertos/task.h"
#include "esp_err.h"
#include "esp_log.h"
#include "esp_random.h"

#include "lvgl.h"
#include "bsp/esp32_p4_wifi6_touch_lcd_7b.h"
#include "bsp/display.h"
#include "driver/jpeg_decode.h"

#include "alert_plate_img.h"

static const char *TAG = "heron_living_loop";

/* ------------------------------------------------------------------ */
/* Embedded MJPEG clips (symbols generated by EMBED_FILES)             */
/* ------------------------------------------------------------------ */
extern const uint8_t idle1_mjpeg_start[] asm("_binary_idle1_mjpeg_start");
extern const uint8_t idle1_mjpeg_end[] asm("_binary_idle1_mjpeg_end");
extern const uint8_t idle2_mjpeg_start[] asm("_binary_idle2_mjpeg_start");
extern const uint8_t idle2_mjpeg_end[] asm("_binary_idle2_mjpeg_end");
extern const uint8_t preen_mjpeg_start[] asm("_binary_preen_mjpeg_start");
extern const uint8_t preen_mjpeg_end[] asm("_binary_preen_mjpeg_end");
extern const uint8_t stride_mjpeg_start[] asm("_binary_stride_mjpeg_start");
extern const uint8_t stride_mjpeg_end[] asm("_binary_stride_mjpeg_end");
extern const uint8_t strike_mjpeg_start[] asm("_binary_strike_mjpeg_start");
extern const uint8_t strike_mjpeg_end[] asm("_binary_strike_mjpeg_end");
extern const uint8_t stretch_mjpeg_start[] asm("_binary_stretch_mjpeg_start");
extern const uint8_t stretch_mjpeg_end[] asm("_binary_stretch_mjpeg_end");
extern const uint8_t flight_mjpeg_start[] asm("_binary_flight_mjpeg_start");
extern const uint8_t flight_mjpeg_end[] asm("_binary_flight_mjpeg_end");
extern const uint8_t miss_mjpeg_start[] asm("_binary_miss_mjpeg_start");
extern const uint8_t miss_mjpeg_end[] asm("_binary_miss_mjpeg_end");
extern const uint8_t courtship_mjpeg_start[] asm("_binary_courtship_mjpeg_start");
extern const uint8_t courtship_mjpeg_end[] asm("_binary_courtship_mjpeg_end");

typedef enum {
    BEH_NONE = 0,
    BEH_PRE,
    BEH_STR,
    BEH_STK,
    BEH_STC,
    BEH_FLI,
    BEH_MIS,
    BEH_COU,
} behavior_t;

typedef struct {
    const char *name;       /* short id used in serial logs */
    behavior_t behavior;    /* BEH_NONE for the two idles */
    const uint8_t *start;
    const uint8_t *end;
    uint32_t frames;        /* verified offline by the SOI/EOI scanner */
    uint32_t fps;
} mjpeg_clip_t;

static const mjpeg_clip_t s_idle1 = { "idle1", BEH_NONE, idle1_mjpeg_start, idle1_mjpeg_end, 120, 12 };
static const mjpeg_clip_t s_idle2 = { "idle2", BEH_NONE, idle2_mjpeg_start, idle2_mjpeg_end,  12, 12 };

static const mjpeg_clip_t s_behaviors[] = {
    { "preen",     BEH_PRE, preen_mjpeg_start,     preen_mjpeg_end,     120, 12 },
    { "stride",    BEH_STR, stride_mjpeg_start,    stride_mjpeg_end,    120, 12 },
    { "strike",    BEH_STK, strike_mjpeg_start,    strike_mjpeg_end,    120, 12 },
    { "stretch",   BEH_STC, stretch_mjpeg_start,   stretch_mjpeg_end,   120, 12 },
    { "flight",    BEH_FLI, flight_mjpeg_start,    flight_mjpeg_end,    120, 12 },
    { "miss",      BEH_MIS, miss_mjpeg_start,      miss_mjpeg_end,      120, 12 },
    { "courtship", BEH_COU, courtship_mjpeg_start, courtship_mjpeg_end, 120, 12 },
};
#define NUM_BEHAVIORS (sizeof(s_behaviors) / sizeof(s_behaviors[0]))

static const mjpeg_clip_t *clip_for_behavior(behavior_t b)
{
    for (size_t i = 0; i < NUM_BEHAVIORS; i++) {
        if (s_behaviors[i].behavior == b) {
            return &s_behaviors[i];
        }
    }
    return NULL;
}

/* ------------------------------------------------------------------ */
/* Frame geometry (Stage A values, unchanged)                          */
/* ------------------------------------------------------------------ */
#define FRAME_W        1024
#define FRAME_H        600
#define FRAME_STRIDE   (FRAME_W * 2)              /* RGB565 bytes per row */
#define FRAME_BYTES    (FRAME_W * FRAME_H * 2)    /* 1,228,800 */
#define OUT_BUF_BYTES  (FRAME_BYTES + 256 * 1024)
/* Largest single frame across ALL Stage B clips is 86,196 B (idle2,
 * measured offline); Stage A's 128 KB input buffer still holds it. */
#define IN_BUF_BYTES   (128 * 1024)

/* Crossfade length: 4 frames at 12 fps ~= 0.33 s. */
#define FADE_FRAMES    4

/* ------------------------------------------------------------------ */
/* Player state                                                        */
/* ------------------------------------------------------------------ */
static lv_obj_t *s_img;
static jpeg_decoder_handle_t s_decoder;
static uint8_t *s_in_buf;
static uint8_t *s_out_buf[2];           /* decode targets, alternating */
static size_t s_out_buf_size[2];
static uint8_t *s_blend_buf;            /* crossfade output */
static size_t s_blend_buf_size;
static uint8_t *s_shown_buf;            /* buffer the descriptor shows */
static int s_decode_slot;               /* next out_buf to decode into */

static lv_image_dsc_t s_frame_dsc = {
    .header = {
        .magic = LV_IMAGE_HEADER_MAGIC,
        .cf = LV_COLOR_FORMAT_RGB565,
        .flags = 0,
        .w = FRAME_W,
        .h = FRAME_H,
        .stride = FRAME_STRIDE,
    },
    .data_size = FRAME_BYTES,
    .data = NULL,
};
static bool s_frame_src_set;

/* Stage A marker scan, unchanged: baseline JPEG byte-stuffing makes
 * FF D8 / FF D9 unambiguous frame boundaries. */
static const uint8_t *scan_to_marker(const uint8_t *p, const uint8_t *end, uint8_t marker)
{
    while (p + 1 < end) {
        if (p[0] == 0xFF && p[1] == marker) {
            return p;
        }
        p++;
    }
    return NULL;
}

static void present_frame(uint8_t *rgb565)
{
    bsp_display_lock(0);
    s_frame_dsc.data = rgb565;
    if (!s_frame_src_set) {
        lv_image_set_src(s_img, &s_frame_dsc);
        lv_obj_set_pos(s_img, 0, 0);
        s_frame_src_set = true;
    }
    lv_obj_invalidate(s_img);
    bsp_display_unlock();
    s_shown_buf = rgb565;
}

/* Blend two RGB565 frames: out = from + (to - from) * num / FADE_FRAMES.
 * Channel math expands to 8-bit, lerps, repacks — the same expansion
 * LVGL uses, so intermediate fade frames hold the endpoints' colors
 * honestly. 614,400 px per blend; runs only at unit joins. */
static void blend_frames(const uint8_t *from, const uint8_t *to,
                         uint8_t *out, uint32_t num)
{
    const uint16_t *a = (const uint16_t *)from;
    const uint16_t *b = (const uint16_t *)to;
    uint16_t *o = (uint16_t *)out;
    const uint32_t n = FRAME_W * FRAME_H;
    for (uint32_t i = 0; i < n; i++) {
        uint32_t av = a[i], bv = b[i];
        uint32_t ar = (av >> 8) & 0xF8, ag = (av >> 3) & 0xFC, ab = (av << 3) & 0xF8;
        uint32_t br = (bv >> 8) & 0xF8, bg = (bv >> 3) & 0xFC, bb = (bv << 3) & 0xF8;
        uint32_t r = ar + ((int32_t)br - (int32_t)ar) * (int32_t)num / FADE_FRAMES;
        uint32_t g = ag + ((int32_t)bg - (int32_t)ag) * (int32_t)num / FADE_FRAMES;
        uint32_t l = ab + ((int32_t)bb - (int32_t)ab) * (int32_t)num / FADE_FRAMES;
        o[i] = (uint16_t)(((r & 0xF8) << 8) | ((g & 0xFC) << 3) | (l >> 3));
    }
}

/* ------------------------------------------------------------------ */
/* Clip playback                                                       */
/* ------------------------------------------------------------------ */
typedef struct {
    const uint8_t *cursor;
    const uint8_t *end;
    uint32_t idx;
} clip_cursor_t;

static const jpeg_decode_cfg_t s_decode_cfg = {
    .output_format = JPEG_DECODE_OUT_FORMAT_RGB565,
    .rgb_order = JPEG_DEC_RGB_ELEMENT_ORDER_BGR,  /* proven in Stage A */
};

/* Decode the next frame of the clip into the next decode slot.
 * Returns the decoded buffer, or NULL at end of clip / on error
 * (errors are logged and skipped, exactly as Stage A). */
static uint8_t *decode_next(clip_cursor_t *c, const mjpeg_clip_t *clip)
{
    const uint8_t *soi = scan_to_marker(c->cursor, c->end, 0xD8);
    if (soi == NULL) {
        return NULL;
    }
    const uint8_t *eoi = scan_to_marker(soi + 2, c->end, 0xD9);
    if (eoi == NULL) {
        ESP_LOGW(TAG, "%s: no EOI after frame %lu — clip truncated?",
                 clip->name, (unsigned long)c->idx);
        return NULL;
    }
    const size_t flen = (size_t)(eoi + 2 - soi);
    c->cursor = eoi + 2;

    if (flen > IN_BUF_BYTES) {
        ESP_LOGW(TAG, "%s frame %lu: %u bytes > input buffer — skipped",
                 clip->name, (unsigned long)c->idx, (unsigned)flen);
        c->idx++;
        return NULL;
    }
    memcpy(s_in_buf, soi, flen);

    if (c->idx == 0) {
        jpeg_decode_picture_info_t info;
        if (jpeg_decoder_get_info(s_in_buf, flen, &info) == ESP_OK) {
            ESP_LOGI(TAG, "%s: JPEG header %lux%lu", clip->name,
                     (unsigned long)info.width, (unsigned long)info.height);
        }
    }

    /* Never decode into the buffer on screen or the blend buffer. */
    int slot = s_decode_slot;
    if (s_out_buf[slot] == s_shown_buf) {
        slot ^= 1;
    }
    uint32_t out_size = 0;
    esp_err_t err = jpeg_decoder_process(s_decoder, &s_decode_cfg,
                                         s_in_buf, flen,
                                         s_out_buf[slot],
                                         (uint32_t)s_out_buf_size[slot],
                                         &out_size);
    c->idx++;
    if (err != ESP_OK) {
        ESP_LOGW(TAG, "%s frame %lu: jpeg_decoder_process %s — skipped",
                 clip->name, (unsigned long)(c->idx - 1), esp_err_to_name(err));
        return NULL;
    }
    if (c->idx == 1) {
        ESP_LOGI(TAG, "%s: decoded frame size %lu bytes (expect %d)",
                 clip->name, (unsigned long)out_size, FRAME_BYTES);
    }
    s_decode_slot = slot ^ 1;
    return s_out_buf[slot];
}

/* Play frame_count frames of a clip (frame_count 0 = whole clip),
 * looping the blob if more frames are requested than the clip holds
 * (the idle2 tile). fade_in crossfades the first FADE_FRAMES frames
 * against whatever is currently on screen. */
static void play_unit(const mjpeg_clip_t *clip, uint32_t frame_count, bool fade_in)
{
    const size_t blob_len = (size_t)(clip->end - clip->start);
    ESP_LOGI(TAG, "unit start: %s — %lu frames @ %lu fps, %u bytes embedded%s",
             clip->name, (unsigned long)clip->frames,
             (unsigned long)clip->fps, (unsigned)blob_len,
             fade_in ? ", crossfade in" : "");

    clip_cursor_t c = { clip->start, clip->end, 0 };
    const uint32_t want = frame_count ? frame_count : clip->frames;
    const TickType_t period = pdMS_TO_TICKS(1000) / clip->fps;
    TickType_t last = xTaskGetTickCount();
    uint32_t played = 0;
    bool fading = fade_in && (s_shown_buf != NULL);
    uint32_t fade_step = 0;

    while (played < want) {
        if (c.cursor >= c.end) {
            if (frame_count > clip->frames) {
                c.cursor = clip->start;   /* tile: wrap to the first frame */
                c.idx = 0;
            } else {
                break;
            }
        }
        uint8_t *frame = decode_next(&c, clip);
        if (frame == NULL) {
            if (c.cursor >= c.end && frame_count <= clip->frames) {
                break;
            }
            vTaskDelayUntil(&last, period);
            continue;
        }
        if (fading && fade_step < FADE_FRAMES) {
            fade_step++;
            blend_frames(s_shown_buf, frame, s_blend_buf, fade_step);
            present_frame(s_blend_buf);
            if (fade_step >= FADE_FRAMES) {
                fading = false;
                present_frame(frame);  /* land exactly on the real frame */
            }
        } else {
            present_frame(frame);
        }
        played++;
        vTaskDelayUntil(&last, period);
    }
}

/* ------------------------------------------------------------------ */
/* Shuffle-bag scheduler (port of living_loop_scheduler.py)            */
/* ------------------------------------------------------------------ */
#define BAG_TICKETS 14
static const struct { behavior_t b; uint32_t n; } s_bag_recipe[] = {
    { BEH_PRE, 3 }, { BEH_STR, 3 }, { BEH_STK, 2 }, { BEH_STC, 2 },
    { BEH_MIS, 2 }, { BEH_FLI, 1 }, { BEH_COU, 1 },
};
static behavior_t s_bag[BAG_TICKETS];
static uint32_t s_bag_pos;              /* next ticket to draw */
static behavior_t s_last_played;
static uint32_t s_draw_no;

static uint32_t rand_below(uint32_t n)
{
    return n ? (esp_random() % n) : 0;
}

static void bag_refill(void)
{
    uint32_t k = 0;
    for (size_t i = 0; i < sizeof(s_bag_recipe) / sizeof(s_bag_recipe[0]); i++) {
        for (uint32_t j = 0; j < s_bag_recipe[i].n; j++) {
            s_bag[k++] = s_bag_recipe[i].b;
        }
    }
    /* Fisher–Yates; re-shuffle until the first ticket cannot repeat the
     * behavior that just played (scheduler law). 14 tickets, at most a
     * 3/14 chance per shuffle — the retry cap is a formality. */
    for (int attempt = 0; attempt < 64; attempt++) {
        for (uint32_t i = BAG_TICKETS - 1; i > 0; i--) {
            uint32_t j = rand_below(i + 1);
            behavior_t t = s_bag[i]; s_bag[i] = s_bag[j]; s_bag[j] = t;
        }
        if (s_last_played == BEH_NONE || s_bag[0] != s_last_played) {
            break;
        }
    }
    s_bag_pos = 0;
    ESP_LOGI(TAG, "bag refilled (14 tickets)%s",
             s_last_played != BEH_NONE ? " — first draw re-rolled off the last behavior" : "");
}

/* One idle hold, 20–90 s, assembled exactly as the reference scheduler:
 * 10 s idle1 blocks sprinkled into long holds, idle2 tiles the rest,
 * unit order shuffled. Units are logged as they play. */
static void play_idle_hold(void)
{
    const uint32_t hold_s = 20 + rand_below(71);   /* 20..90 s */
    ESP_LOGI(TAG, "idle hold: %lu s", (unsigned long)hold_s);

    typedef struct { const mjpeg_clip_t *clip; uint32_t frames; } unit_t;
    unit_t units[10];
    uint32_t n_units = 0;
    uint32_t remaining = hold_s;
    while (remaining >= 30 && n_units < 9) {
        if (rand_below(2)) {
            units[n_units++] = (unit_t){ &s_idle1, 120 };
            remaining -= 10;
        } else {
            break;
        }
    }
    if (remaining > 0) {
        units[n_units++] = (unit_t){ &s_idle2, remaining * 12 };
    }
    for (uint32_t i = n_units - 1; i > 0; i--) {
        uint32_t j = rand_below(i + 1);
        unit_t t = units[i]; units[i] = units[j]; units[j] = t;
    }
    for (uint32_t i = 0; i < n_units; i++) {
        play_unit(units[i].clip, units[i].frames, true);
    }
}

static void player_task(void *arg)
{
    (void)arg;

    /* The boot plate is the portrait's face: let it sit a beat before
     * the first (faded) motion, as in Stage A. */
    vTaskDelay(pdMS_TO_TICKS(1500));

    /* Move the plate into a frame buffer and point the widget at the
     * copy (identical pixels), so even the first join — plate into the
     * opening idle hold — can crossfade instead of cutting. */
    memcpy(s_out_buf[0], alert_plate_img.data, FRAME_BYTES);
    present_frame(s_out_buf[0]);
    s_decode_slot = 1;

    s_last_played = BEH_NONE;
    s_draw_no = 0;
    bag_refill();

    play_idle_hold();                   /* opens on stillness */
    while (1) {
        if (s_bag_pos >= BAG_TICKETS) {
            ESP_LOGI(TAG, "bag emptied — reshuffle");
            bag_refill();
        }
        behavior_t b = s_bag[s_bag_pos++];
        const mjpeg_clip_t *clip = clip_for_behavior(b);
        s_draw_no++;
        ESP_LOGI(TAG, "draw #%lu: %s (%lu ticket(s) left in bag)",
                 (unsigned long)s_draw_no, clip->name,
                 (unsigned long)(BAG_TICKETS - s_bag_pos));
        play_unit(clip, 0, true);
        s_last_played = b;
        play_idle_hold();               /* stillness between every draw */
    }
}

void app_main(void)
{
    ESP_LOGI(TAG, "heron living loop — STAGE B (shuffle-bag + crossfade)");
    const uint32_t seed = esp_random();
    ESP_LOGI(TAG, "random seed (esp_random): %lu", (unsigned long)seed);

    /* Display path identical to first light / Stage A. */
    lv_display_t *disp = bsp_display_start();
    if (disp == NULL) {
        ESP_LOGE(TAG, "bsp_display_start() failed — no display");
        return;
    }
    ESP_ERROR_CHECK(bsp_display_brightness_set(100));

    bsp_display_lock(0);
    lv_obj_t *scr = lv_screen_active();
    lv_obj_remove_flag(scr, LV_OBJ_FLAG_SCROLLABLE);
    s_img = lv_image_create(scr);
    lv_image_set_src(s_img, &alert_plate_img);
    lv_obj_set_pos(s_img, 0, 0);
    lv_obj_remove_flag(s_img, LV_OBJ_FLAG_SCROLLABLE);
    bsp_display_unlock();

    ESP_LOGI(TAG, "boot plate on screen (%dx%d RGB565)", BSP_LCD_H_RES, BSP_LCD_V_RES);

    /* --- Hardware JPEG decoder + buffers (Stage A + blend) --------- */
    jpeg_decode_engine_cfg_t eng_cfg = {
        .intr_priority = 0,
        .timeout_ms = 100,
    };
    esp_err_t err = jpeg_new_decoder_engine(&eng_cfg, &s_decoder);
    if (err != ESP_OK) {
        ESP_LOGE(TAG, "jpeg_new_decoder_engine: %s — staying on the still plate",
                 esp_err_to_name(err));
        while (1) {
            vTaskDelay(pdMS_TO_TICKS(1000));
        }
    }

    jpeg_decode_memory_alloc_cfg_t in_alloc_cfg = {
        .buffer_direction = JPEG_DEC_ALLOC_INPUT_BUFFER,
    };
    jpeg_decode_memory_alloc_cfg_t out_alloc_cfg = {
        .buffer_direction = JPEG_DEC_ALLOC_OUTPUT_BUFFER,
    };
    size_t in_size = 0;
    s_in_buf = jpeg_alloc_decoder_mem(IN_BUF_BYTES, &in_alloc_cfg, &in_size);
    s_out_buf[0] = jpeg_alloc_decoder_mem(OUT_BUF_BYTES, &out_alloc_cfg, &s_out_buf_size[0]);
    s_out_buf[1] = jpeg_alloc_decoder_mem(OUT_BUF_BYTES, &out_alloc_cfg, &s_out_buf_size[1]);
    s_blend_buf = jpeg_alloc_decoder_mem(OUT_BUF_BYTES, &out_alloc_cfg, &s_blend_buf_size);
    if (s_in_buf == NULL || s_out_buf[0] == NULL || s_out_buf[1] == NULL || s_blend_buf == NULL) {
        ESP_LOGE(TAG, "decoder buffer allocation failed — staying on the still plate");
        while (1) {
            vTaskDelay(pdMS_TO_TICKS(1000));
        }
    }
    ESP_LOGI(TAG, "decoder buffers: in %u B, out %u + %u B, blend %u B (PSRAM)",
             (unsigned)in_size, (unsigned)s_out_buf_size[0],
             (unsigned)s_out_buf_size[1], (unsigned)s_blend_buf_size);

    xTaskCreate(player_task, "heron_player", 8192, NULL, 5, NULL);
    ESP_LOGI(TAG, "player task running — living loop is live");
}
