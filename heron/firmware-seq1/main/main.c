/*
 * heron — SEQUENCE 1 player (the drawn strike, 2026-11-05).
 *
 * Boot shows the marsh home frame (the bird's rest portrait), then a
 * player task loops forever: play sequence 1 (the strike, 60 frames
 * @ 12 fps = 5 s), return to the single rest frame and hold it, repeat.
 * The sequence starts and ends on the home frame itself, so every cut
 * is clean. The rest hold length is a runtime choice (REST_HOLD_MS),
 * never baked into the assets.
 *
 * Board : Waveshare ESP32-P4-WIFI6-Touch-LCD-7B (Rev1.1), 1024x600 MIPI-DSI
 * BSP   : waveshare/esp32_p4_wifi6_touch_lcd_7b 1.0.4 (main/idf_component.yml)
 * Decode: ESP32-P4 hardware JPEG decoder (esp_driver_jpeg), YUV422 MJPEG
 *         frames -> RGB565, presented through the same LVGL image widget
 *         that shows the boot plate. Player core is the proven Stage A
 *         living-loop code, unchanged but for the clip table and the
 *         rest-hold step.
 *
 * Assets are embedded with CMake EMBED_FILES (see main/CMakeLists.txt):
 *   seq1.mjpeg  60 hand-drawn frames @ 12 fps, PIL JPEG q82 4:2:2
 *               (subsampling=1; SOF luma byte 0x21 verified per frame —
 *               the P4 hardware decoder's sampling requirement)
 *   rest.jpg    the single home frame (marsh composite), same encode
 *
 * Attribution (per project rule): all 60 frames were drawn fresh by
 * Mordecai on 2026-11-05 from the canonical home drawing
 * (K_coil_color_redo.png) and the project's reference library
 * (~/workspace/heron/reference-footage/). Choreography and timing were
 * taken from that library — principally fb-weber-sashimi.mp4 (neck
 * mechanics) and fb-davesmith-strike.mp4 (strike timing) — used as
 * motion reference only; no clip frames appear in the artwork.
 * The marsh background is the approved plate marsh_plate_pick.png,
 * composited by multiply blend at the locked home registration.
 *
 * FLIGHT (added 2026-11-05): a pair of MJPEG clips that always run
 * back-to-back — flight_out.mjpeg (36 frames: takeoff, a fast crossing
 * on surge-weighted beats, and a stretched final flap that carries the
 * bird out of frame) and flight_home.mjpeg (53 frames: re-entry from
 * the left edge, descent, flare, landing, settle onto the home marks).
 * Between them the player holds the single marsh plate (plate.jpg) for
 * FLIGHT_GAP_MS (30 s, Jimmy's ruling) — the bird is away; the gap is a
 * runtime hold of one still, never stored frames. Frames drawn fresh
 * by Mordecai 2026-11-05 from the home drawing and the reference
 * library's flight material (Boga slow-motion flight reels, the
 * Teague takeoff, the Astroland winter flight, Mark Smith's glide-in)
 * — motion reference only; no clip frames appear in the artwork.
 * Composite register matches the rest of the set (paper normalized to
 * the home paper, selective de-yellow toward the plate's own paper,
 * multiply over the plate).
 */
#include <stddef.h>
#include <stdint.h>
#include <string.h>

#include "freertos/FreeRTOS.h"
#include "freertos/task.h"
#include "esp_err.h"
#include "esp_log.h"

#include "lvgl.h"
#include "bsp/esp32_p4_wifi6_touch_lcd_7b.h"
#include "bsp/display.h"
#include "driver/jpeg_decode.h"

#include "alert_plate_img.h"

static const char *TAG = "heron_seq1";

/* ------------------------------------------------------------------ */
/* Embedded MJPEG clips (symbols generated by EMBED_FILES)             */
/* ------------------------------------------------------------------ */
extern const uint8_t seq1_mjpeg_start[] asm("_binary_seq1_mjpeg_start");
extern const uint8_t seq1_mjpeg_end[] asm("_binary_seq1_mjpeg_end");
extern const uint8_t rest_jpg_start[] asm("_binary_rest_jpg_start");
extern const uint8_t rest_jpg_end[] asm("_binary_rest_jpg_end");
/* Flight assets live in the 'assets' data partition (esptool caps a
 * single app-image flash segment at 16 MB, and the set's embedded
 * rodata would exceed it with flight included). assets.bin layout:
 * a 64 KB header page (magic + per-asset offset/length), then each
 * asset at a 64 KB boundary. The player mmaps one asset at a time. */
#include "esp_partition.h"
#include "esp_random.h"
#define ASSETS_MAGIC 0x54534148u /* 'HAST' little-endian */
enum { ASSET_FLIGHT_OUT = 0, ASSET_FLIGHT_HOME = 1, ASSET_PLATE = 2, ASSET_COUNT = 3 };
static const esp_partition_t *s_assets_part;
static uint32_t s_asset_off[ASSET_COUNT];
static uint32_t s_asset_len[ASSET_COUNT];
static bool s_assets_ok;

static bool assets_init(void)
{
    s_assets_part = esp_partition_find_first(ESP_PARTITION_TYPE_DATA,
                                             ESP_PARTITION_SUBTYPE_ANY, "assets");
    if (s_assets_part == NULL) {
        ESP_LOGW(TAG, "assets partition not found — flight disabled");
        return false;
    }
    esp_partition_mmap_handle_t h;
    const void *p = NULL;
    if (esp_partition_mmap(s_assets_part, 0, 64 * 1024,
                           ESP_PARTITION_MMAP_DATA, &p, &h) != ESP_OK) {
        ESP_LOGW(TAG, "assets header mmap failed — flight disabled");
        return false;
    }
    const uint32_t *hdr = (const uint32_t *)p;
    bool ok = (hdr[0] == ASSETS_MAGIC);
    if (ok) {
        for (int i = 0; i < ASSET_COUNT; i++) {
            s_asset_off[i] = hdr[1 + 2 * i];
            s_asset_len[i] = hdr[2 + 2 * i];
            if (s_asset_off[i] + s_asset_len[i] > s_assets_part->size) {
                ok = false;
            }
        }
    }
    esp_partition_munmap(h);
    if (!ok) {
        ESP_LOGW(TAG, "assets header invalid — flight disabled");
        return false;
    }
    ESP_LOGI(TAG, "assets ready: out %lu B @ %lu, home %lu B @ %lu, plate %lu B @ %lu",
             (unsigned long)s_asset_len[0], (unsigned long)s_asset_off[0],
             (unsigned long)s_asset_len[1], (unsigned long)s_asset_off[1],
             (unsigned long)s_asset_len[2], (unsigned long)s_asset_off[2]);
    return true;
}

/* Map one asset; caller munmaps the returned handle when done. */
static const uint8_t *asset_map(int idx, esp_partition_mmap_handle_t *out_h)
{
    const void *p = NULL;
    if (esp_partition_mmap(s_assets_part, s_asset_off[idx], s_asset_len[idx],
                           ESP_PARTITION_MMAP_DATA, &p, out_h) != ESP_OK) {
        ESP_LOGW(TAG, "asset %d mmap failed", idx);
        return NULL;
    }
    return (const uint8_t *)p;
}

typedef struct {
    const char *name;
    const uint8_t *start;
    const uint8_t *end;
    uint32_t frames; /* verified offline by the SOI/EOI scanner */
    uint32_t fps;
} mjpeg_clip_t;

static const mjpeg_clip_t s_clips[] = {
    { "seq1 (the strike, drawn 2026-11-05)", seq1_mjpeg_start, seq1_mjpeg_end, 60, 12 },
};

/* Flight pair (played by play_flight, not the s_clips loop). The
 * start/end pointers are filled in per play from the assets mmap. */
static mjpeg_clip_t flight_out_clip = {
    "flight OUT (takeoff -> stretched-flap exit)", NULL, NULL, 36, 12 };
static mjpeg_clip_t flight_home_clip = {
    "flight HOME (left-edge entry -> landing -> settle)", NULL, NULL, 53, 12 };

/* How long the bird is away between the two flight clips: the player
 * holds the single marsh plate for this long (Jimmy: 30 s). */
#define FLIGHT_GAP_MS 30000

/* How long the rest frame holds between plays of the sequence.
 * A runtime choice only — the home frame is also the sequence's own
 * first/last frame, so the hold is invisible as a cut. */
#define REST_HOLD_MS 9000

/* ------------------------------------------------------------------ */
/* Frame geometry                                                      */
/* ------------------------------------------------------------------ */
#define FRAME_W        1024
#define FRAME_H        600
#define FRAME_STRIDE   (FRAME_W * 2)              /* RGB565 bytes per row */
#define FRAME_BYTES    (FRAME_W * FRAME_H * 2)    /* 1,228,800 */
/* Decoder output slack: the P4 decoder may pad the output height for
 * subsampled sources; 256 KB of headroom makes the buffer un-overflowable
 * for any 1024-wide variant (worst case 1024x608 = +16 KB). */
#define OUT_BUF_BYTES  (FRAME_BYTES + 256 * 1024)
/* Largest single JPEG frame in either clip is 42,007 bytes (measured). */
#define IN_BUF_BYTES   (128 * 1024)

/* ------------------------------------------------------------------ */
/* Player state                                                        */
/* ------------------------------------------------------------------ */
static lv_obj_t *s_img;                 /* the fullscreen image widget */
static jpeg_decoder_handle_t s_decoder;
static uint8_t *s_in_buf;               /* one JPEG frame, decoder-format */
static uint8_t *s_out_buf[2];           /* double-buffered RGB565 output */
static size_t s_out_buf_size[2];        /* allocated size of each buffer */
static int s_front;                     /* index currently on screen */

/* Mutable twin of the plate descriptor: same header, data pointer swapped
 * per frame (under the display lock) to the just-decoded buffer. */
static lv_image_dsc_t s_frame_dsc = {
    .header = {
        .magic = LV_IMAGE_HEADER_MAGIC,
        .cf = LV_COLOR_FORMAT_RGB565,
        .flags = 0,
        .w = FRAME_W,
        .h = FRAME_H,
        .stride = FRAME_STRIDE,
    },
    .data_size = FRAME_BYTES,
    .data = NULL,
};
static bool s_frame_src_set;

/* Find the next FF xx marker pair at or after p.
 *
 * A naive scan is sound for baseline JPEG: inside entropy-coded data a
 * 0xFF byte is ALWAYS byte-stuffed with a following 0x00, so the pairs
 * FF D8 (SOI) and FF D9 (EOI) can only occur as real frame markers.
 * This exact scanner was run over both embedded blobs offline during
 * the build: it consumes each blob exactly (120 / 12 frames, zero
 * trailing bytes) and every extracted frame decodes standalone. */
static const uint8_t *scan_to_marker(const uint8_t *p, const uint8_t *end, uint8_t marker)
{
    while (p + 1 < end) {
        if (p[0] == 0xFF && p[1] == marker) {
            return p;
        }
        p++;
    }
    return NULL;
}

/* Present a decoded frame through the boot plate's image widget. */
static void present_frame(uint8_t *rgb565)
{
    bsp_display_lock(0);
    s_frame_dsc.data = rgb565;
    if (!s_frame_src_set) {
        lv_image_set_src(s_img, &s_frame_dsc);
        lv_obj_set_pos(s_img, 0, 0);
        s_frame_src_set = true;
    }
    lv_obj_invalidate(s_img);
    bsp_display_unlock();
}

/* Play one clip start to finish, paced to its frame rate. Decoder
 * errors skip the frame — they never hang the player. */
static void play_clip(const mjpeg_clip_t *clip)
{
    const size_t blob_len = (size_t)(clip->end - clip->start);
    ESP_LOGI(TAG, "clip start: %s — %lu frames @ %lu fps, %u bytes embedded",
             clip->name, (unsigned long)clip->frames,
             (unsigned long)clip->fps, (unsigned)blob_len);

    static const jpeg_decode_cfg_t decode_cfg = {
        .output_format = JPEG_DECODE_OUT_FORMAT_RGB565,
        /* KNOWN UNKNOWN (see README): BGR is the element order Espressif's
         * own decode example uses and the header pairs it with the
         * small-endian output the (proven) plate data uses. If the panel
         * shows red/blue swapped, flip this one line to
         * JPEG_DEC_RGB_ELEMENT_ORDER_RGB. */
        .rgb_order = JPEG_DEC_RGB_ELEMENT_ORDER_BGR,
    };

    const TickType_t period = pdMS_TO_TICKS(1000) / clip->fps;
    TickType_t last = xTaskGetTickCount();
    const uint8_t *cursor = clip->start;
    uint32_t idx = 0;

    while (cursor < clip->end) {
        const uint8_t *soi = scan_to_marker(cursor, clip->end, 0xD8);
        if (soi == NULL) {
            break;
        }
        const uint8_t *eoi = scan_to_marker(soi + 2, clip->end, 0xD9);
        if (eoi == NULL) {
            ESP_LOGW(TAG, "%s: no EOI after frame %lu — clip truncated?",
                     clip->name, (unsigned long)idx);
            break;
        }
        const size_t flen = (size_t)(eoi + 2 - soi);
        cursor = eoi + 2;

        if (flen > IN_BUF_BYTES) {
            ESP_LOGW(TAG, "%s frame %lu: %u bytes > input buffer — skipped",
                     clip->name, (unsigned long)idx, (unsigned)flen);
        } else {
            memcpy(s_in_buf, soi, flen);

            if (idx == 0) {
                jpeg_decode_picture_info_t info;
                if (jpeg_decoder_get_info(s_in_buf, flen, &info) == ESP_OK) {
                    ESP_LOGI(TAG, "%s: JPEG header %lux%lu",
                             clip->name, (unsigned long)info.width,
                             (unsigned long)info.height);
                }
            }

            const int back = s_front ^ 1;
            uint32_t out_size = 0;
            /* NOTE: the v5.5 header's jpeg_decoder_process takes the
             * output buffer's size as well (the online v5.5.1 doc
             * example lags the header and omits it). */
            esp_err_t err = jpeg_decoder_process(s_decoder, &decode_cfg,
                                                 s_in_buf, flen,
                                                 s_out_buf[back],
                                                 (uint32_t)s_out_buf_size[back],
                                                 &out_size);
            if (err == ESP_OK) {
                if (idx == 0) {
                    ESP_LOGI(TAG, "%s: decoded frame size %lu bytes (expect %d)",
                             clip->name, (unsigned long)out_size, FRAME_BYTES);
                }
                present_frame(s_out_buf[back]);
                s_front = back;
            } else {
                ESP_LOGW(TAG, "%s frame %lu: jpeg_decoder_process %s — skipped",
                         clip->name, (unsigned long)idx, esp_err_to_name(err));
            }
        }

        idx++;
        vTaskDelayUntil(&last, period);
    }
}

/* Decode the single rest frame (the marsh home frame) and put it on
 * screen. This is the bird's still position between sequences. */
/* ---- idle sequence: timing-table player (choreography idle.md S.1a) ----
 * 300 ticks @ 12 fps = 25.0 s from 10 drawings: 0=HOME (the rest frame)
 * 1=BLINK 2=SACCADE_MID_R 3=SACCADE_R 4=TILT_MID 5=TILT_FULL (Jimmy kept
 * the frontal glare) 6..9=SCAN_1..SCAN_END. Held ticks repeat for free:
 * the pose JPEG is decoded only when the schedule changes pose.
 * Events: 2 blinks, saccade R, roll tilt out / hold / release, saccade
 * back, the one eased slow scan L, saccade return. Held fraction 0.92. */
extern const uint8_t p1_blink_jpg_start[] asm("_binary_p1_blink_jpg_start");
extern const uint8_t p1_blink_jpg_end[]   asm("_binary_p1_blink_jpg_end");
extern const uint8_t p2_sacmid_jpg_start[] asm("_binary_p2_sacmid_jpg_start");
extern const uint8_t p2_sacmid_jpg_end[]   asm("_binary_p2_sacmid_jpg_end");
extern const uint8_t p3_sacr_jpg_start[] asm("_binary_p3_sacr_jpg_start");
extern const uint8_t p3_sacr_jpg_end[]   asm("_binary_p3_sacr_jpg_end");
extern const uint8_t p4_tiltmid_jpg_start[] asm("_binary_p4_tiltmid_jpg_start");
extern const uint8_t p4_tiltmid_jpg_end[]   asm("_binary_p4_tiltmid_jpg_end");
extern const uint8_t p5_tiltfull_jpg_start[] asm("_binary_p5_tiltfull_jpg_start");
extern const uint8_t p5_tiltfull_jpg_end[]   asm("_binary_p5_tiltfull_jpg_end");
extern const uint8_t p6_scan1_jpg_start[] asm("_binary_p6_scan1_jpg_start");
extern const uint8_t p6_scan1_jpg_end[]   asm("_binary_p6_scan1_jpg_end");
extern const uint8_t p7_scan2_jpg_start[] asm("_binary_p7_scan2_jpg_start");
extern const uint8_t p7_scan2_jpg_end[]   asm("_binary_p7_scan2_jpg_end");
extern const uint8_t p8_scan3_jpg_start[] asm("_binary_p8_scan3_jpg_start");
extern const uint8_t p8_scan3_jpg_end[]   asm("_binary_p8_scan3_jpg_end");
extern const uint8_t p9_scanend_jpg_start[] asm("_binary_p9_scanend_jpg_start");
extern const uint8_t p9_scanend_jpg_end[]   asm("_binary_p9_scanend_jpg_end");

static const uint8_t *const idle_pose_start[10] = {
    rest_jpg_start, p1_blink_jpg_start, p2_sacmid_jpg_start,
    p3_sacr_jpg_start, p4_tiltmid_jpg_start, p5_tiltfull_jpg_start,
    p6_scan1_jpg_start, p7_scan2_jpg_start, p8_scan3_jpg_start,
    p9_scanend_jpg_start,
};
static const uint8_t *const idle_pose_end[10] = {
    rest_jpg_end, p1_blink_jpg_end, p2_sacmid_jpg_end,
    p3_sacr_jpg_end, p4_tiltmid_jpg_end, p5_tiltfull_jpg_end,
    p6_scan1_jpg_end, p7_scan2_jpg_end, p8_scan3_jpg_end,
    p9_scanend_jpg_end,
};
static const uint8_t idle_sched[300] = { 0, 0, 0, 0, 0, 0, 0, 0, 0, 0, 0, 0, 0,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 0, 0 };

static void play_idle(void)
{
    static const jpeg_decode_cfg_t decode_cfg = {
        .output_format = JPEG_DECODE_OUT_FORMAT_RGB565,
        .rgb_order = JPEG_DEC_RGB_ELEMENT_ORDER_BGR,
    };
    ESP_LOGI(TAG, "idle start — 300 ticks @ 12 fps, timing-table player");
    const TickType_t period = pdMS_TO_TICKS(1000) / 12;
    TickType_t last = xTaskGetTickCount();
    int cur_pose = -1;
    for (int t = 0; t < 300; t++) {
        const int pose = idle_sched[t];
        if (pose != cur_pose) {
            const size_t flen = (size_t)(idle_pose_end[pose] - idle_pose_start[pose]);
            if (flen > IN_BUF_BYTES) {
                ESP_LOGW(TAG, "idle tick %d: pose %d too big — skipped", t, pose);
            } else {
                memcpy(s_in_buf, idle_pose_start[pose], flen);
                const int back = s_front ^ 1;
                uint32_t out_size = 0;
                esp_err_t err = jpeg_decoder_process(s_decoder, &decode_cfg,
                                                     s_in_buf, flen,
                                                     s_out_buf[back],
                                                     (uint32_t)s_out_buf_size[back],
                                                     &out_size);
                if (err == ESP_OK) {
                    present_frame(s_out_buf[back]);
                    s_front = back;
                    cur_pose = pose;
                } else {
                    ESP_LOGW(TAG, "idle tick %d: pose %d decode %s — skipped",
                             t, pose, esp_err_to_name(err));
                }
            }
        }
        vTaskDelayUntil(&last, period);
    }
}

/* ---- stretch sequence: timing-table player (choreography stretch.md) ----
 * 96 ticks @ 12 fps = 8.0 s from 10 drawings: 0=HOME (the rest frame)
 * 1=DEPARTURE 2=WEIGHT 3=TUCKED 4..6=FAN_1..FAN_3 (near wing down+back)
 * 7=LEG_1/3 8=LEG_2/3 9=FULL_STRETCH_HOLD (fan + same-side leg straight
 * back at body height). The hold is ONE drawing repeated 24 ticks.
 * Choreography is the movement chart / study form (same-side wing+leg);
 * the supplied clip (stretch_attempt1.mp4; firmware-living-loop/
 * stageb_clips/stretch.mjpeg) is a both-wing warble with no leg
 * extension and was used as timing-texture reference only — chart wins
 * every disagreement (stretch.md S.7). Return reuses the extension
 * grades in reverse; LEG_REPLANT is FAN_3 itself (both feet home), and
 * the final tick is the exact HOME drawing. */
extern const uint8_t q1_dep_jpg_start[] asm("_binary_q1_dep_jpg_start");
extern const uint8_t q1_dep_jpg_end[]   asm("_binary_q1_dep_jpg_end");
extern const uint8_t q2_weight_jpg_start[] asm("_binary_q2_weight_jpg_start");
extern const uint8_t q2_weight_jpg_end[]   asm("_binary_q2_weight_jpg_end");
extern const uint8_t q3_tucked_jpg_start[] asm("_binary_q3_tucked_jpg_start");
extern const uint8_t q3_tucked_jpg_end[]   asm("_binary_q3_tucked_jpg_end");
extern const uint8_t q4_fan1_jpg_start[] asm("_binary_q4_fan1_jpg_start");
extern const uint8_t q4_fan1_jpg_end[]   asm("_binary_q4_fan1_jpg_end");
extern const uint8_t q5_fan2_jpg_start[] asm("_binary_q5_fan2_jpg_start");
extern const uint8_t q5_fan2_jpg_end[]   asm("_binary_q5_fan2_jpg_end");
extern const uint8_t q6_fan3_jpg_start[] asm("_binary_q6_fan3_jpg_start");
extern const uint8_t q6_fan3_jpg_end[]   asm("_binary_q6_fan3_jpg_end");
extern const uint8_t q7_leg1_jpg_start[] asm("_binary_q7_leg1_jpg_start");
extern const uint8_t q7_leg1_jpg_end[]   asm("_binary_q7_leg1_jpg_end");
extern const uint8_t q8_leg2_jpg_start[] asm("_binary_q8_leg2_jpg_start");
extern const uint8_t q8_leg2_jpg_end[]   asm("_binary_q8_leg2_jpg_end");
extern const uint8_t q9_full_jpg_start[] asm("_binary_q9_full_jpg_start");
extern const uint8_t q9_full_jpg_end[]   asm("_binary_q9_full_jpg_end");

static const uint8_t *const stretch_pose_start[10] = {
    rest_jpg_start, q1_dep_jpg_start, q2_weight_jpg_start,
    q3_tucked_jpg_start, q4_fan1_jpg_start, q5_fan2_jpg_start,
    q6_fan3_jpg_start, q7_leg1_jpg_start, q8_leg2_jpg_start,
    q9_full_jpg_start,
};
static const uint8_t *const stretch_pose_end[10] = {
    rest_jpg_end, q1_dep_jpg_end, q2_weight_jpg_end,
    q3_tucked_jpg_end, q4_fan1_jpg_end, q5_fan2_jpg_end,
    q6_fan3_jpg_end, q7_leg1_jpg_end, q8_leg2_jpg_end,
    q9_full_jpg_end,
};
static const uint8_t stretch_sched[96] = { 0, 0, 0, 1, 1, 1, 1, 1, 1, 2, 2, 2, 2,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 0, 0 };

static void play_stretch(void)
{
    static const jpeg_decode_cfg_t decode_cfg = {
        .output_format = JPEG_DECODE_OUT_FORMAT_RGB565,
        .rgb_order = JPEG_DEC_RGB_ELEMENT_ORDER_BGR,
    };
    ESP_LOGI(TAG, "stretch start — 96 ticks @ 12 fps, timing-table player");
    const TickType_t period = pdMS_TO_TICKS(1000) / 12;
    TickType_t last = xTaskGetTickCount();
    int cur_pose = -1;
    for (int t = 0; t < 96; t++) {
        const int pose = stretch_sched[t];
        if (pose != cur_pose) {
            const size_t flen = (size_t)(stretch_pose_end[pose] - stretch_pose_start[pose]);
            if (flen > IN_BUF_BYTES) {
                ESP_LOGW(TAG, "stretch tick %d: pose %d too big — skipped", t, pose);
            } else {
                memcpy(s_in_buf, stretch_pose_start[pose], flen);
                const int back = s_front ^ 1;
                uint32_t out_size = 0;
                esp_err_t err = jpeg_decoder_process(s_decoder, &decode_cfg,
                                                     s_in_buf, flen,
                                                     s_out_buf[back],
                                                     (uint32_t)s_out_buf_size[back],
                                                     &out_size);
                if (err == ESP_OK) {
                    present_frame(s_out_buf[back]);
                    s_front = back;
                    cur_pose = pose;
                } else {
                    ESP_LOGW(TAG, "stretch tick %d: pose %d decode %s — skipped",
                             t, pose, esp_err_to_name(err));
                }
            }
        }
        vTaskDelayUntil(&last, period);
    }
}

/* ---- preen sequence: timing-table player (choreography preen.md) ----
 * 132 ticks @ 12 fps = 11.0 s from 10 drawings: 0=HOME (the rest frame)
 * 1=DEP_MID 2=BACKWARD_GLANCE (the reach mid Jimmy approved) 3=SHOULDER
 * 4=NIBBLE (bill closed on a feather) 5=DRAW_THROUGH (bill parted, one
 * feather sliding through — the chart's signature beat, absent from the
 * source clip) 6=CHEST (bill buried in the plume fringe) 7=WING BOUT on
 * the stretch FAN_2 blob (q5_fan2 — wing half-open, head tucked at its
 * front; Jimmy approved this fallback 2026-11-05 after head-under-wing
 * failed two drawing routes) 8=SHAKE (plays as oscillation vs pose 7)
 * 9=SETTLE. Chart order shoulder -> chest -> wing; chart beats win over
 * the clip (preen_attempt1.mp4 / stageb_clips/preen.mjpeg — continuous
 * sweep, reversed bout order, no shake or draw-through) per preen.md S.7.
 * Closing: A13 recoil + A14 = 30 ticks on the exact HOME drawing. */
extern const uint8_t r1_depmid_jpg_start[] asm("_binary_r1_depmid_jpg_start");
extern const uint8_t r1_depmid_jpg_end[]   asm("_binary_r1_depmid_jpg_end");
extern const uint8_t r2_glance_jpg_start[] asm("_binary_r2_glance_jpg_start");
extern const uint8_t r2_glance_jpg_end[]   asm("_binary_r2_glance_jpg_end");
extern const uint8_t r3_shoulder_jpg_start[] asm("_binary_r3_shoulder_jpg_start");
extern const uint8_t r3_shoulder_jpg_end[]   asm("_binary_r3_shoulder_jpg_end");
extern const uint8_t r4_nibble_jpg_start[] asm("_binary_r4_nibble_jpg_start");
extern const uint8_t r4_nibble_jpg_end[]   asm("_binary_r4_nibble_jpg_end");
extern const uint8_t r5_draw_jpg_start[] asm("_binary_r5_draw_jpg_start");
extern const uint8_t r5_draw_jpg_end[]   asm("_binary_r5_draw_jpg_end");
extern const uint8_t r6_chest_jpg_start[] asm("_binary_r6_chest_jpg_start");
extern const uint8_t r6_chest_jpg_end[]   asm("_binary_r6_chest_jpg_end");
extern const uint8_t r7_shake_jpg_start[] asm("_binary_r7_shake_jpg_start");
extern const uint8_t r7_shake_jpg_end[]   asm("_binary_r7_shake_jpg_end");
extern const uint8_t r8_settle_jpg_start[] asm("_binary_r8_settle_jpg_start");
extern const uint8_t r8_settle_jpg_end[]   asm("_binary_r8_settle_jpg_end");

static const uint8_t *const preen_pose_start[10] = {
    rest_jpg_start, r1_depmid_jpg_start, r2_glance_jpg_start,
    r3_shoulder_jpg_start, r4_nibble_jpg_start, r5_draw_jpg_start,
    r6_chest_jpg_start, q5_fan2_jpg_start, r7_shake_jpg_start,
    r8_settle_jpg_start,
};
static const uint8_t *const preen_pose_end[10] = {
    rest_jpg_end, r1_depmid_jpg_end, r2_glance_jpg_end,
    r3_shoulder_jpg_end, r4_nibble_jpg_end, r5_draw_jpg_end,
    r6_chest_jpg_end, q5_fan2_jpg_end, r7_shake_jpg_end,
    r8_settle_jpg_end,
};
static const uint8_t preen_sched[132] = { 0, 0, 0, 1, 1, 1, 1, 1, 1, 2, 2, 2, 2,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 0, 0 };

static void play_preen(void)
{
    static const jpeg_decode_cfg_t decode_cfg = {
        .output_format = JPEG_DECODE_OUT_FORMAT_RGB565,
        .rgb_order = JPEG_DEC_RGB_ELEMENT_ORDER_BGR,
    };
    ESP_LOGI(TAG, "preen start — 132 ticks @ 12 fps, timing-table player");
    const TickType_t period = pdMS_TO_TICKS(1000) / 12;
    TickType_t last = xTaskGetTickCount();
    int cur_pose = -1;
    for (int t = 0; t < 132; t++) {
        const int pose = preen_sched[t];
        if (pose != cur_pose) {
            const size_t flen = (size_t)(preen_pose_end[pose] - preen_pose_start[pose]);
            if (flen > IN_BUF_BYTES) {
                ESP_LOGW(TAG, "preen tick %d: pose %d too big — skipped", t, pose);
            } else {
                memcpy(s_in_buf, preen_pose_start[pose], flen);
                const int back = s_front ^ 1;
                uint32_t out_size = 0;
                esp_err_t err = jpeg_decoder_process(s_decoder, &decode_cfg,
                                                     s_in_buf, flen,
                                                     s_out_buf[back],
                                                     (uint32_t)s_out_buf_size[back],
                                                     &out_size);
                if (err == ESP_OK) {
                    present_frame(s_out_buf[back]);
                    s_front = back;
                    cur_pose = pose;
                } else {
                    ESP_LOGW(TAG, "preen tick %d: pose %d decode %s — skipped",
                             t, pose, esp_err_to_name(err));
                }
            }
        }
        vTaskDelayUntil(&last, period);
    }
}


/* ===== Sequence 5: LISTENING (drawn 2026-11-06) =====
 * Replaces the old "miss" in the set (Jimmy's design, 2026-11-05).
 * The pair as one timing-table pass, 252 ticks @ 12 fps = 21.0 s:
 * RISE 36 (home -> rise0 -> rise1 -> the pose), the POSE held on its
 * single frame for 180 ticks (15.0 s — a stored frame, never a clip),
 * SETTLE 36 back down the same grades to the exact home frame.
 * Pose proof anatomy: fb-alvarez-standing.mp4 (Facebook, Alvarez —
 * standing heron, neck at full extension), drawn fresh in the set's
 * graphite + subtle-color register from the home drawing. */
extern const uint8_t s1_rise0_jpg_start[] asm("_binary_s1_rise0_jpg_start");
extern const uint8_t s1_rise0_jpg_end[]   asm("_binary_s1_rise0_jpg_end");
extern const uint8_t s2_rise1_jpg_start[] asm("_binary_s2_rise1_jpg_start");
extern const uint8_t s2_rise1_jpg_end[]   asm("_binary_s2_rise1_jpg_end");
extern const uint8_t s3_pose_jpg_start[]  asm("_binary_s3_pose_jpg_start");
extern const uint8_t s3_pose_jpg_end[]    asm("_binary_s3_pose_jpg_end");

static const uint8_t *const listen_pose_start[4] = {
    rest_jpg_start, s1_rise0_jpg_start, s2_rise1_jpg_start, s3_pose_jpg_start,
};
static const uint8_t *const listen_pose_end[4] = {
    rest_jpg_end, s1_rise0_jpg_end, s2_rise1_jpg_end, s3_pose_jpg_end,
};
static const uint8_t listen_sched[252] = { 0, 0, 0, 0, 0, 0, 1, 1, 1, 1, 1, 1, 1,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 0, 0 };

static void play_listening(void)
{
    static const jpeg_decode_cfg_t decode_cfg = {
        .output_format = JPEG_DECODE_OUT_FORMAT_RGB565,
        .rgb_order = JPEG_DEC_RGB_ELEMENT_ORDER_BGR,
    };
    ESP_LOGI(TAG, "listening start — 252 ticks @ 12 fps, timing-table player");
    const TickType_t period = pdMS_TO_TICKS(1000) / 12;
    TickType_t last = xTaskGetTickCount();
    int cur_pose = -1;
    for (int t = 0; t < 252; t++) {
        const int pose = listen_sched[t];
        if (pose != cur_pose) {
            const size_t flen = (size_t)(listen_pose_end[pose] - listen_pose_start[pose]);
            if (flen > IN_BUF_BYTES) {
                ESP_LOGW(TAG, "listening tick %d: pose %d too big — skipped", t, pose);
            } else {
                memcpy(s_in_buf, listen_pose_start[pose], flen);
                const int back = s_front ^ 1;
                uint32_t out_size = 0;
                esp_err_t err = jpeg_decoder_process(s_decoder, &decode_cfg,
                                                     s_in_buf, flen,
                                                     s_out_buf[back],
                                                     (uint32_t)s_out_buf_size[back],
                                                     &out_size);
                if (err == ESP_OK) {
                    present_frame(s_out_buf[back]);
                    s_front = back;
                    cur_pose = pose;
                } else {
                    ESP_LOGW(TAG, "listening tick %d: pose %d decode %s — skipped",
                             t, pose, esp_err_to_name(err));
                }
            }
        }
        vTaskDelayUntil(&last, period);
    }
}

static void show_rest(void)
{
    static const jpeg_decode_cfg_t decode_cfg = {
        .output_format = JPEG_DECODE_OUT_FORMAT_RGB565,
        .rgb_order = JPEG_DEC_RGB_ELEMENT_ORDER_BGR,
    };
    const size_t flen = (size_t)(rest_jpg_end - rest_jpg_start);
    if (flen > IN_BUF_BYTES) {
        ESP_LOGW(TAG, "rest frame: %u bytes > input buffer — skipped", (unsigned)flen);
        return;
    }
    memcpy(s_in_buf, rest_jpg_start, flen);
    const int back = s_front ^ 1;
    uint32_t out_size = 0;
    esp_err_t err = jpeg_decoder_process(s_decoder, &decode_cfg,
                                         s_in_buf, flen,
                                         s_out_buf[back],
                                         (uint32_t)s_out_buf_size[back],
                                         &out_size);
    if (err == ESP_OK) {
        present_frame(s_out_buf[back]);
        s_front = back;
    } else {
        ESP_LOGW(TAG, "rest frame: jpeg_decoder_process %s — skipped",
                 esp_err_to_name(err));
    }
}

/* Decode the marsh plate (no bird) and put it on screen — shown while
 * the bird is away between the flight clips. */
static void show_plate(void)
{
    static const jpeg_decode_cfg_t decode_cfg = {
        .output_format = JPEG_DECODE_OUT_FORMAT_RGB565,
        .rgb_order = JPEG_DEC_RGB_ELEMENT_ORDER_BGR,
    };
    esp_partition_mmap_handle_t h;
    const uint8_t *plate = asset_map(ASSET_PLATE, &h);
    if (plate == NULL) {
        return;
    }
    const size_t flen = (size_t)s_asset_len[ASSET_PLATE];
    if (flen > IN_BUF_BYTES) {
        ESP_LOGW(TAG, "plate frame: %u bytes > input buffer — skipped", (unsigned)flen);
        esp_partition_munmap(h);
        return;
    }
    memcpy(s_in_buf, plate, flen);
    esp_partition_munmap(h);
    const int back = s_front ^ 1;
    uint32_t out_size = 0;
    esp_err_t err = jpeg_decoder_process(s_decoder, &decode_cfg,
                                         s_in_buf, flen,
                                         s_out_buf[back],
                                         (uint32_t)s_out_buf_size[back],
                                         &out_size);
    if (err == ESP_OK) {
        present_frame(s_out_buf[back]);
        s_front = back;
    } else {
        ESP_LOGW(TAG, "plate frame: jpeg_decoder_process %s — skipped",
                 esp_err_to_name(err));
    }
}

/* The flight pair: OUT -> plate hold (the bird is away) -> HOME.
 * Each clip is mmap'd only while it plays. */
static void play_flight(void)
{
    if (!s_assets_ok) {
        ESP_LOGW(TAG, "flight skipped — assets unavailable");
        return;
    }
    esp_partition_mmap_handle_t h;
    const uint8_t *p = asset_map(ASSET_FLIGHT_OUT, &h);
    if (p == NULL) {
        return;
    }
    flight_out_clip.start = p;
    flight_out_clip.end = p + s_asset_len[ASSET_FLIGHT_OUT];
    play_clip(&flight_out_clip);
    esp_partition_munmap(h);

    show_plate();
    ESP_LOGI(TAG, "flight: bird away — holding the empty marsh %d ms", FLIGHT_GAP_MS);
    vTaskDelay(pdMS_TO_TICKS(FLIGHT_GAP_MS));

    p = asset_map(ASSET_FLIGHT_HOME, &h);
    if (p == NULL) {
        return;
    }
    flight_home_clip.start = p;
    flight_home_clip.end = p + s_asset_len[ASSET_FLIGHT_HOME];
    play_clip(&flight_home_clip);
    esp_partition_munmap(h);
}

static void play_strike_behavior(void)
{
    play_clip(&s_clips[0]);
}

/* ===== Playback order: shuffle-bag (Jimmy, 2026-11-06) =====
 * The behaviors play in a random NON-REPEATING order: a bag holding
 * each behavior once is shuffled (Fisher-Yates on the hardware RNG),
 * played through with the home rest between behaviors, then a fresh
 * bag is drawn. One guard across the seam: the new bag's first
 * behavior is never the previous bag's last, so nothing ever plays
 * twice in a row. Add STRIDE here when it ships — one row. */
typedef void (*behavior_fn_t)(void);
static const struct { const char *name; behavior_fn_t fn; } s_behaviors[] = {
    { "strike",    play_strike_behavior },
    { "idle",      play_idle },
    { "stretch",   play_stretch },
    { "preen",     play_preen },
    { "flight",    play_flight },
    { "listening", play_listening },
};
#define N_BEHAVIORS (sizeof(s_behaviors) / sizeof(s_behaviors[0]))

static void player_task(void *arg)
{
    (void)arg;

    /* Let the boot plate sit for a beat — it is the portrait's face and
     * the visual proof the display path is alive before motion starts. */
    vTaskDelay(pdMS_TO_TICKS(1500));

    uint32_t bag_no = 0;
    int prev_last = -1;
    while (1) {
        int order[N_BEHAVIORS];
        for (size_t i = 0; i < N_BEHAVIORS; i++) {
            order[i] = (int)i;
        }
        for (size_t i = N_BEHAVIORS - 1; i > 0; i--) {
            const size_t j = esp_random() % (i + 1);
            const int tmp = order[i];
            order[i] = order[j];
            order[j] = tmp;
        }
        if (prev_last >= 0 && order[0] == prev_last) {
            const size_t j = 1 + esp_random() % (N_BEHAVIORS - 1);
            const int tmp = order[0];
            order[0] = order[j];
            order[j] = tmp;
        }
        bag_no++;
        ESP_LOGI(TAG, "shuffle bag %lu: %s, %s, %s, %s, %s, %s",
                 (unsigned long)bag_no,
                 s_behaviors[order[0]].name, s_behaviors[order[1]].name,
                 s_behaviors[order[2]].name, s_behaviors[order[3]].name,
                 s_behaviors[order[4]].name, s_behaviors[order[5]].name);
        for (size_t k = 0; k < N_BEHAVIORS; k++) {
            const int b = order[k];
            s_behaviors[b].fn();
            show_rest();
            ESP_LOGI(TAG, "%s done (bag %lu, %u of %u) — resting %d ms",
                     s_behaviors[b].name, (unsigned long)bag_no,
                     (unsigned)(k + 1), (unsigned)N_BEHAVIORS, REST_HOLD_MS);
            vTaskDelay(pdMS_TO_TICKS(REST_HOLD_MS));
        }
        prev_last = order[N_BEHAVIORS - 1];
    }
}

void app_main(void)
{
    ESP_LOGI(TAG, "heron — SEQUENCE 1 player (drawn strike + rest frame)");
    ESP_LOGI(TAG, "embedded payload: seq1 %u bytes + rest %u bytes",
             (unsigned)(seq1_mjpeg_end - seq1_mjpeg_start),
             (unsigned)(rest_jpg_end - rest_jpg_start));

    /* Panel + LVGL port + GT911 touch, all initialised by the BSP —
     * identical display path to first light (the board sits rotated
     * 180° in its case and reads upright exactly as configured here;
     * do not add rotation or mirroring). */
    lv_display_t *disp = bsp_display_start();
    if (disp == NULL) {
        ESP_LOGE(TAG, "bsp_display_start() failed — no display");
        return;
    }
    ESP_ERROR_CHECK(bsp_display_brightness_set(100));

    bsp_display_lock(0);
    lv_obj_t *scr = lv_screen_active();
    lv_obj_remove_flag(scr, LV_OBJ_FLAG_SCROLLABLE);
    s_img = lv_image_create(scr);
    lv_image_set_src(s_img, &alert_plate_img);
    lv_obj_set_pos(s_img, 0, 0);
    lv_obj_remove_flag(s_img, LV_OBJ_FLAG_SCROLLABLE);
    bsp_display_unlock();

    ESP_LOGI(TAG, "boot plate on screen (%dx%d RGB565)", BSP_LCD_H_RES, BSP_LCD_V_RES);

    /* --- Hardware JPEG decoder + buffers --------------------------- */
    jpeg_decode_engine_cfg_t eng_cfg = {
        .intr_priority = 0,
        .timeout_ms = 100,
    };
    esp_err_t err = jpeg_new_decoder_engine(&eng_cfg, &s_decoder);
    if (err != ESP_OK) {
        ESP_LOGE(TAG, "jpeg_new_decoder_engine: %s — staying on the still plate",
                 esp_err_to_name(err));
        while (1) {
            vTaskDelay(pdMS_TO_TICKS(1000));
        }
    }

    jpeg_decode_memory_alloc_cfg_t in_alloc_cfg = {
        .buffer_direction = JPEG_DEC_ALLOC_INPUT_BUFFER,
    };
    jpeg_decode_memory_alloc_cfg_t out_alloc_cfg = {
        .buffer_direction = JPEG_DEC_ALLOC_OUTPUT_BUFFER,
    };
    size_t in_size = 0;
    s_in_buf = jpeg_alloc_decoder_mem(IN_BUF_BYTES, &in_alloc_cfg, &in_size);
    s_out_buf[0] = jpeg_alloc_decoder_mem(OUT_BUF_BYTES, &out_alloc_cfg, &s_out_buf_size[0]);
    s_out_buf[1] = jpeg_alloc_decoder_mem(OUT_BUF_BYTES, &out_alloc_cfg, &s_out_buf_size[1]);
    if (s_in_buf == NULL || s_out_buf[0] == NULL || s_out_buf[1] == NULL) {
        ESP_LOGE(TAG, "decoder buffer allocation failed — staying on the still plate");
        while (1) {
            vTaskDelay(pdMS_TO_TICKS(1000));
        }
    }
    ESP_LOGI(TAG, "decoder buffers: in %u B, out %u + %u B (PSRAM)",
             (unsigned)in_size, (unsigned)s_out_buf_size[0],
             (unsigned)s_out_buf_size[1]);

    s_assets_ok = assets_init();

    xTaskCreate(player_task, "heron_player", 8192, NULL, 5, NULL);
    ESP_LOGI(TAG, "player task running — idle loop is live");
}
